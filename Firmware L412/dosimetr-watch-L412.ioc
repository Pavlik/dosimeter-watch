# file: dosimetr-watch-L412.ioc
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Mcu.Family=STM32L4
Mcu.Name=STM32L412KBTx
Mcu.Package=LQFP32
NVIC.PriorityGroup=NVIC_PRIORITYGROUP_4
PA13\ (JTMS/SWDIO).Mode=Serial_Wire
PA13\ (JTMS/SWDIO).Signal=SYS_JTMS-SWDIO
PA14\ (JTCK/SWCLK).Mode=Serial_Wire
PA14\ (JTCK/SWCLK).Signal=SYS_JTCK-SWCLK
ProjectManager.HeapSize=0x200
ProjectManager.StackSize=0x400
ProjectManager.TargetToolchain=STM32CubeIDE
RCC.ADCFreq_Value=24000000
RCC.AHBFreq_Value=24000000
RCC.APB1Freq_Value=24000000
RCC.APB1TimFreq_Value=24000000
RCC.APB2Freq_Value=24000000
RCC.APB2TimFreq_Value=24000000
RCC.CortexFreq_Value=24000000
RCC.HCLKFreq_Value=24000000
RCC.HSE_VALUE=8000000
RCC.HSI48_VALUE=48000000
RCC.HSI_VALUE=16000000
RCC.LSE_VALUE=32768
RCC.MSI_VALUE=4000000
RCC.PLLN=9
RCC.PLLR=RCC_PLLR_DIV6
RCC.PLLSourceVirtual=RCC_PLLSOURCE_HSI
RCC.SYSCLKFreq_VALUE=24000000
RCC.SYSCLKSource=RCC_SYSCLKSOURCE_PLLCLK
RCC.USBFreq_Value=4000000
RCC.VCOOutputFreq_Value=144000000
board=custom

// file: Core/Src/main.c
/* USER CODE BEGIN Header */
/**
  ******************************************************************************
  * @file           : main.c
  * @brief          : Main program body
  ******************************************************************************
  * @attention
  *
  * Copyright (c) 2026 STMicroelectronics.
  * All rights reserved.
  *
  * This software is licensed under terms that can be found in the LICENSE file
  * in the root directory of this software component.
  * If no LICENSE file comes with this software, it is provided AS-IS.
  *
  ******************************************************************************
  */
/* USER CODE END Header */

#include "main.h"

/* USER CODE BEGIN Includes */
#include "adc_test.h"
/* USER CODE END Includes */

void SystemClock_Config(void);
static void MX_GPIO_Init(void);

int main(void)
{

  /* MCU Configuration--------------------------------------------------------*/

  /* Reset of all peripherals, Initializes the Flash interface and the Systick. */
  HAL_Init();

  /* Configure the system clock */
  SystemClock_Config();

  /* Initialize all configured peripherals */
  MX_GPIO_Init();
  /* USER CODE BEGIN 2 */

 	RCC->AHB2ENR |= RCC_AHB2ENR_GPIOAEN;

 	/*GPIO SYSTEM LED CONFIG START*/

 	GPIOA->MODER &= ~GPIO_MODER_MODE3;
 	GPIOA->MODER |= GPIO_MODER_MODE3_0;//|= (1Ul << GPIO_MODER_MODE3_Pos); // GPIO_MODER_MODE3_0;

 	/*GPIO SYSTEM LED CONFIG END*/

 	/*GPIO AS ADC CHANNELS CONFIG START*/

	GPIOA->MODER &= ~GPIO_MODER_MODE0;
	GPIOA->MODER |= 3UL << GPIO_MODER_MODE0_Pos; //PA0 as ADC1 CH5

	GPIOA->MODER &= ~GPIO_MODER_MODE1;
	GPIOA->MODER |= 3UL << GPIO_MODER_MODE1_Pos; //PA1 as ADC1 CH6

	GPIOA->MODER &= ~GPIO_MODER_MODE2;
	GPIOA->MODER |= 3UL << GPIO_MODER_MODE2_Pos; //PA2 as ADC1 CH7

 	/*GPIO AS ADC CHANNELS CONFIG END*/

 	/*GPIO UART RX/TX PA9-PA10 CONFIG START*/

 	 GPIOA->MODER &= ~GPIO_MODER_MODE10;
 	 GPIOA->MODER |= GPIO_MODER_MODE10_1; // 10 - af
 	 GPIOA->MODER &= ~GPIO_MODER_MODE9;
 	 GPIOA->MODER |= GPIO_MODER_MODE9_1; // 10 - af

 	 GPIOA->AFR[1] |= (7UL << GPIO_AFRH_AFSEL10_Pos) | (7UL << GPIO_AFRH_AFSEL9_Pos); // set PA9 and PA10 as AF7

 	/*GPIO UART RX/TX PA9-PA10 CONFIG END*/

 	/*UART1 CONFIG START*/

 	 RCC->APB2ENR |= RCC_APB2ENR_USART1EN;
 	 RCC->CCIPR &= ~RCC_CCIPR_USART1SEL;
 	 USART1->CR1 &= ~USART_CR1_UE;

 	 /*Baudrate = 115200* BRR = 24000000 / 115200 = 208.33*/

 	 USART1->BRR = 208;

 	 USART1->CR1 = USART_CR1_TE | USART_CR1_RE; // ENABLE UART1 RX/TX
 	 USART1->CR1 |= USART_CR1_UE; // ENABLE UART1

 	 /*DMA1 ADC CONFIG START*/

 	 RCC->AHB1ENR |= RCC_AHB1ENR_DMA1EN; // enable DMA clock

 	 /*DMA1 ADC CONFIG END*/

 	 DWT_Delay_Init();
 	 ADC_TEST_DMA_Circular_TRGO_Init();

  	/*TIM15 CONFIG START*/

  	RCC->APB2ENR |= RCC_APB2ENR_TIM15EN;

  	TIM15->PSC = 24000-1;
  	TIM15->ARR = 1000-1;
  	TIM15->CNT = 0;

  	TIM15->EGR |= TIM_EGR_UG;
  	TIM15->SR = ~TIM_SR_UIF;

  	TIM15->CR2 &= ~TIM_CR2_MMS;
  	TIM15->CR2 |= TIM_CR2_MMS_1; // TRGO = Update Evint

  	TIM15->CR1 |= TIM_CR1_CEN;

  	/*TIM15 CONFIG END*/

 	/*TIM16 CONFIG START*/

 	RCC->APB2ENR |= RCC_APB2ENR_TIM16EN;

 	TIM16->PSC = 24000-1;
 	TIM16->ARR = 1000-1;
 	TIM16->CNT = 0;
 	TIM16->EGR = TIM_EGR_UG;
 	TIM16->SR = ~TIM_SR_UIF;
 	TIM16->DIER |= TIM_DIER_UIE;
 	NVIC_SetPriority(TIM1_UP_TIM16_IRQn, 0);
 	NVIC_EnableIRQ(TIM1_UP_TIM16_IRQn);

 	TIM16->CR1 |= TIM_CR1_CEN;

 	/*TIM16 CONFIG END*/

 	uart_send_init();

  /* USER CODE END 2 */

  /* Infinite loop */
  /* USER CODE BEGIN WHILE */
  while (1)
  {

	  ADC_Test_DMA_Circular_TRGO_While();

    /* USER CODE END WHILE */

  }
}

void SystemClock_Config(void)
{
  RCC_OscInitTypeDef RCC_OscInitStruct = {0};
  RCC_ClkInitTypeDef RCC_ClkInitStruct = {0};

  /** Configure the main internal regulator output voltage
  */
  if (HAL_PWREx_ControlVoltageScaling(PWR_REGULATOR_VOLTAGE_SCALE1) != HAL_OK)
  {
    Error_Handler();
  }

  /** Initializes the RCC Oscillators according to the specified parameters
  * in the RCC_OscInitTypeDef structure.
  */
  RCC_OscInitStruct.OscillatorType = RCC_OSCILLATORTYPE_HSI;
  RCC_OscInitStruct.HSIState = RCC_HSI_ON;
  RCC_OscInitStruct.HSICalibrationValue = RCC_HSICALIBRATION_DEFAULT;
  RCC_OscInitStruct.PLL.PLLState = RCC_PLL_ON;
  RCC_OscInitStruct.PLL.PLLSource = RCC_PLLSOURCE_HSI;
  RCC_OscInitStruct.PLL.PLLM = 1;
  RCC_OscInitStruct.PLL.PLLN = 9;
  RCC_OscInitStruct.PLL.PLLQ = RCC_PLLQ_DIV2;
  RCC_OscInitStruct.PLL.PLLR = RCC_PLLR_DIV6;
  if (HAL_RCC_OscConfig(&RCC_OscInitStruct) != HAL_OK)
  {
    Error_Handler();
  }

  /** Initializes the CPU, AHB and APB buses clocks
  */
  RCC_ClkInitStruct.ClockType = RCC_CLOCKTYPE_HCLK|RCC_CLOCKTYPE_SYSCLK
                              |RCC_CLOCKTYPE_PCLK1|RCC_CLOCKTYPE_PCLK2;
  RCC_ClkInitStruct.SYSCLKSource = RCC_SYSCLKSOURCE_PLLCLK;
  RCC_ClkInitStruct.AHBCLKDivider = RCC_SYSCLK_DIV1;
  RCC_ClkInitStruct.APB1CLKDivider = RCC_HCLK_DIV1;
  RCC_ClkInitStruct.APB2CLKDivider = RCC_HCLK_DIV1;

  if (HAL_RCC_ClockConfig(&RCC_ClkInitStruct, FLASH_LATENCY_1) != HAL_OK)
  {
    Error_Handler();
  }
}

static void MX_GPIO_Init(void)
{

  /* GPIO Ports Clock Enable */
  __HAL_RCC_GPIOA_CLK_ENABLE();

}

void Error_Handler(void)
{
  __disable_irq();
  while (1)
  {
  }
}
